## conf/layer.conf
```bitbake
# We have a conf and classes directory, add to BBPATH
BBPATH .= ":${LAYERDIR}"

# We have recipes-* directories, add to BBFILES
BBFILES += "${LAYERDIR}/recipes-*/*/*.bb \
	${LAYERDIR}/recipes-*/*/*.bbappend"

BBFILE_COLLECTIONS += "mx6-Hurricane"
BBFILE_PATTERN_mx6-Hurricane = "^${LAYERDIR}/"
BBFILE_PRIORITY_mx6-Hurricane = "6"
```
